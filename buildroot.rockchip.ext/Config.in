## buildroot.rockchip.ext/package/Config.in
```kconfig
menu "Packages"
# source "$BR2_EXTERNAL_RK3588_PATH/package/rkbin/Config.in"
# source "$BR2_EXTERNAL_RK3588_PATH/package/rkbin3588/Config.in"
# source "$BR2_EXTERNAL_RK3588_PATH/package/rktools/Config.in"
# source "$BR2_EXTERNAL_RK3588_PATH/package/rkdevice/Config.in"
# source "$BR2_EXTERNAL_RK3588_PATH/package/rtk_hciattach/Config.in"
# source "$BR2_EXTERNAL_RK3588_PATH/package/example-module-overlay/Config.in"
endmenu
```
